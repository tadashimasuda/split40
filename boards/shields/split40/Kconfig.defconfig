## boards/shields/split40/Kconfig.shield
```kconfig
config SHIELD_SPLIT40_L
    def_bool $(shields_list_contains,Split40_L)

config SHIELD_SPLIT40_R
    def_bool $(shields_list_contains,Split40_R)
```
